## examples/robot/ragtime_panthera/main/Kconfig.projbuild
```kconfig
menu "Example Configuration"

    config DEBUG_MODE
        bool "Enable debugging using the console"
        default y
        help
            Use the console to enable robotic arm position control and other feature debugging.

    config IKINE_TEST
        bool "Test whether points within the range can be solved by inverse kinematics"
        default n
        help
            Inverse kinematics test

endmenu
```

## examples/robotic/arm_control/components/dofbot/Kconfig.projbuild
```kconfig
menu "Robotic Arm Options"

    config JOINT2_GROUND_DISTANCE_MM
        int "Distance from ground to Joint 2 (mm)"
        default 121
        help
        Vertical distance from the ground plane to Joint 2 of the robot arm, in millimeters.

    config JOINT2_TO_JOINT3_DISTANCE_MM
        int "Distance from Joint 2 to Joint 3 (mm)"
        default 82
        help
        Horizontal or link distance between Joint 2 and Joint 3 of the robot arm, in millimeters.

    config JOINT3_TO_JOINT4_DISTANCE_MM
        int "Distance from Joint 3 to Joint 4 (mm)"
        default 82
        help
        Link distance between Joint 3 and Joint 4 of the robot arm, in millimeters.

    config JOINT4_TO_END_EFFECTOR_DISTANCE_MM
        int "Distance from Joint 4 to End Effector (mm)"
        default 185
        help
        Distance from Joint 4 to the end effector (tool center point) of the robot arm, in millimeters.

endmenu
```

## examples/robotic/arm_control/main/Kconfig.projbuild
```kconfig
menu "Example Configuration"
    config EXAMPLE_CAM_BUF_COUNT
        int "Camera Buffer Count"
        default 2
        range 2 3

    config EXAMPLE_QWEN_API_KEY
        string "Qwen API Key"
        default "my_api_key"
        help
            API key for Qwen model.

endmenu
```

## examples/usb/device/uac_test/main/Kconfig.projbuild
```kconfig
menu "Example Config"

    choice TINYUSB_RHPORT
        prompt "TinyUSB Root Port"
        default TINYUSB_RHPORT_HS if IDF_TARGET_ESP32P4
        default TINYUSB_RHPORT_FS
        help
            Allows set the USB PHY Controller for TinyUSB: HS (USB OTG2.0 PHY for HighSpeed)

        config TINYUSB_RHPORT_HS
            depends on IDF_TARGET_ESP32P4
            bool "High Speed"

        config TINYUSB_RHPORT_FS
            bool "Full Speed"
    endchoice

endmenu
```
